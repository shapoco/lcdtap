// USB Mass Storage Mode
//
// Presents the LcdTap framebuffer as a single read-only FAT12 disk image
// containing one file: frame_buffer.png (PNG 24bpp, uncompressed DEFLATE).
//
// PNG is generated byte-by-byte on demand (seekable, zero extra RAM).
// Checksums (Adler-32, CRC32) are precomputed once from the frozen framebuf.

#include "usb_msc.hpp"

#include <cstring>

#include "hardware/gpio.h"
#include "hardware/watchdog.h"
#include "pico/stdlib.h"
#include "pico/unique_id.h"
#include "tusb.h"

#include "config.h"

// =============================================================================
// CRC32 (IEEE 802.3 / zlib / PNG)
// =============================================================================

static uint32_t crc32Init() { return 0xFFFFFFFFu; }

static uint32_t crc32Update(uint32_t crc, const uint8_t *data, size_t len) {
  for (size_t i = 0; i < len; ++i) {
    crc ^= data[i];
    for (int j = 0; j < 8; ++j) crc = (crc >> 1) ^ (0xEDB88320u & -(crc & 1u));
  }
  return crc;
}

static uint32_t crc32Finalize(uint32_t crc) { return crc ^ 0xFFFFFFFFu; }

static uint32_t crc32Buf(const uint8_t *data, size_t len) {
  return crc32Finalize(crc32Update(crc32Init(), data, len));
}

// =============================================================================
// Adler-32 (zlib checksum used in PNG zlib stream)
// =============================================================================

static void adler32Update(uint32_t &s1, uint32_t &s2, uint8_t byte) {
  s1 = (s1 + byte) % 65521u;
  s2 = (s2 + s1) % 65521u;
}

// =============================================================================
// PNG snapshot
// =============================================================================

// ROW_STRIDE: 5 (deflate block header) + 1 (filter byte) + W*3 (RGB888 pixels)
// IDAT_PAYLOAD_SIZE: 2 (zlib header) + H * ROW_STRIDE + 4 (Adler-32)
// PNG_FILE_SIZE: 8 (sig) + 25 (IHDR) + 8 (IDAT hdr) + IDAT_PAYLOAD_SIZE
//                + 4 (IDAT CRC) + 12 (IEND)

struct PngSnapshot {
  const uint16_t *framebuf;
  uint32_t lcdWidth;
  uint32_t lcdHeight;
  uint32_t width;
  uint32_t height;
  bool inverted;
  bool swapRB;
  uint8_t rotation;
  uint32_t adler32;
  uint32_t ihdrCrc32;
  uint32_t idatCrc32;
  uint32_t fileSize;
  uint32_t idatPayloadSize;
};

static PngSnapshot gSnap;
static bool gSnapReady = false;
static lcdtap::LcdTap *gInstUsb = nullptr;
static uint32_t gFileSizeUsb = 0u;
static uint32_t gVolumeSerialUsb = 0x04030201u;
static bool gInvertedUsb = false;
static bool gSwapRbUsb = false;
static uint8_t gOutputRotationUsb = 0u;

static LCDTAP_INLINE void rgb565To888(uint16_t px, uint8_t &r, uint8_t &g,
                                      uint8_t &b) {
  uint8_t r5 = (px >> 11) & 0x1Fu;
  uint8_t g6 = (px >> 5) & 0x3Fu;
  uint8_t b5 = px & 0x1Fu;
  r = (r5 << 3) | (r5 >> 2);
  g = (g6 << 2) | (g6 >> 4);
  b = (b5 << 3) | (b5 >> 2);
}

static LCDTAP_INLINE uint16_t applyPixelFlags(uint16_t px, bool inverted,
                                              bool swap_rb) {
  if (inverted) {
    px ^= 0xFFFFu;
  }
  if (swap_rb) {
    px = static_cast<uint16_t>((px & 0x07E0u) | ((px & 0x001Fu) << 11u) |
                               ((px & 0xF800u) >> 11u));
  }
  return px;
}

static LCDTAP_INLINE uint16_t snapshotPixelAt(const PngSnapshot *snap,
                                              uint32_t x, uint32_t y) {
  uint32_t srcX = x;
  uint32_t srcY = y;

  switch (snap->rotation & 3u) {
    default:
    case 0u:
      // rot=0: normal
      break;
    case 1u:
      // rot=1: 90° CW
      srcX = y;
      srcY = snap->lcdHeight - 1u - x;
      break;
    case 2u:
      // rot=2: 180°
      srcX = snap->lcdWidth - 1u - x;
      srcY = snap->lcdHeight - 1u - y;
      break;
    case 3u:
      // rot=3: 270° CW
      srcX = snap->lcdWidth - 1u - y;
      srcY = x;
      break;
  }

  const uint16_t px = snap->framebuf[srcY * snap->lcdWidth + srcX];
  return applyPixelFlags(px, snap->inverted, snap->swapRB);
}

static void pngSnapshotInit(PngSnapshot *snap, lcdtap::LcdTap *inst) {
  snap->framebuf = inst->getFramebuf();
  snap->lcdWidth = inst->getConfig().lcdWidth;
  snap->lcdHeight = inst->getConfig().lcdHeight;
  snap->inverted = gInvertedUsb;
  snap->swapRB = gSwapRbUsb;
  snap->rotation = gOutputRotationUsb & 3u;

  if ((snap->rotation & 1u) != 0u) {
    snap->width = snap->lcdHeight;
    snap->height = snap->lcdWidth;
  } else {
    snap->width = snap->lcdWidth;
    snap->height = snap->lcdHeight;
  }

  const uint32_t W = snap->width;
  const uint32_t H = snap->height;
  const uint32_t ROW_STRIDE = 5u + 1u + W * 3u;
  const uint32_t LEN = 1u + W * 3u;  // filter byte + pixels per row
  const uint32_t IDAT_PAYLOAD_SIZE = 2u + H * ROW_STRIDE + 4u;
  snap->idatPayloadSize = IDAT_PAYLOAD_SIZE;
  snap->fileSize = 8u + 25u + (4u + 4u + IDAT_PAYLOAD_SIZE + 4u) + 12u;

  // ---- IHDR CRC32 (covers "IHDR" + 13 data bytes) ----
  uint8_t ihdrCrcBuf[17];
  ihdrCrcBuf[0] = 'I';
  ihdrCrcBuf[1] = 'H';
  ihdrCrcBuf[2] = 'D';
  ihdrCrcBuf[3] = 'R';
  ihdrCrcBuf[4] = (W >> 24) & 0xFF;
  ihdrCrcBuf[5] = (W >> 16) & 0xFF;
  ihdrCrcBuf[6] = (W >> 8) & 0xFF;
  ihdrCrcBuf[7] = W & 0xFF;
  ihdrCrcBuf[8] = (H >> 24) & 0xFF;
  ihdrCrcBuf[9] = (H >> 16) & 0xFF;
  ihdrCrcBuf[10] = (H >> 8) & 0xFF;
  ihdrCrcBuf[11] = H & 0xFF;
  ihdrCrcBuf[12] = 8;  // bit depth
  ihdrCrcBuf[13] = 2;  // color type: RGB
  ihdrCrcBuf[14] = 0;  // compression: deflate
  ihdrCrcBuf[15] = 0;  // filter: adaptive
  ihdrCrcBuf[16] = 0;  // interlace: none
  snap->ihdrCrc32 = crc32Buf(ihdrCrcBuf, 17);

  // ---- Adler-32 + IDAT CRC32 in one framebuf pass ----
  uint32_t adlerS1 = 1u, adlerS2 = 0u;
  uint32_t idatCrc = crc32Init();

  const uint8_t idatType[4] = {'I', 'D', 'A', 'T'};
  idatCrc = crc32Update(idatCrc, idatType, 4);

  const uint8_t zlibHdr[2] = {0x78, 0x01};
  idatCrc = crc32Update(idatCrc, zlibHdr, 2);

  for (uint32_t y = 0; y < H; ++y) {
    bool lastRow = (y == H - 1u);
    uint16_t len16 = static_cast<uint16_t>(LEN);
    uint16_t nlen16 = ~len16;
    uint8_t blkHdr[5] = {
        static_cast<uint8_t>(lastRow ? 0x01u : 0x00u),
        static_cast<uint8_t>(len16 & 0xFFu),
        static_cast<uint8_t>(len16 >> 8u),
        static_cast<uint8_t>(nlen16 & 0xFFu),
        static_cast<uint8_t>(nlen16 >> 8u),
    };
    idatCrc = crc32Update(idatCrc, blkHdr, 5);

    const uint8_t filterByte = 0x00u;
    idatCrc = crc32Update(idatCrc, &filterByte, 1);
    adler32Update(adlerS1, adlerS2, filterByte);

    for (uint32_t x = 0; x < W; ++x) {
      uint8_t r, g, b;
      rgb565To888(snapshotPixelAt(snap, x, y), r, g, b);
      const uint8_t px[3] = {r, g, b};
      idatCrc = crc32Update(idatCrc, px, 3);
      adler32Update(adlerS1, adlerS2, r);
      adler32Update(adlerS1, adlerS2, g);
      adler32Update(adlerS1, adlerS2, b);
    }
  }

  snap->adler32 = (adlerS2 << 16u) | adlerS1;

  const uint8_t adlerBe[4] = {
      static_cast<uint8_t>((snap->adler32 >> 24u) & 0xFFu),
      static_cast<uint8_t>((snap->adler32 >> 16u) & 0xFFu),
      static_cast<uint8_t>((snap->adler32 >> 8u) & 0xFFu),
      static_cast<uint8_t>(snap->adler32 & 0xFFu),
  };
  idatCrc = crc32Update(idatCrc, adlerBe, 4);
  snap->idatCrc32 = crc32Finalize(idatCrc);
}

// Returns the byte at file offset `offset` within the PNG stream.
// Computed entirely from the snapshot (no buffering needed).
static LCDTAP_INLINE uint8_t pngByteAt(const PngSnapshot *snap,
                                       uint32_t offset) {
  const uint32_t W = snap->width;
  const uint32_t H = snap->height;
  const uint32_t ROW_STRIDE = 5u + 1u + W * 3u;
  const uint32_t LEN = 1u + W * 3u;

  // PNG signature [0..7]
  static const uint8_t PNG_SIG[8] = {137, 80, 78, 71, 13, 10, 26, 10};
  if (offset < 8u) return PNG_SIG[offset];

  // IHDR chunk [8..32]: 4 (len) + 4 (type) + 13 (data) + 4 (crc) = 25 bytes
  if (offset < 33u) {
    uint32_t i = offset - 8u;
    // Length field: 0x0000000D = 13
    if (i < 4u) return i == 2u ? 0x00u : i == 3u ? 0x0Du : 0x00u;
    i -= 4u;
    // Type field: "IHDR"
    if (i < 4u) return static_cast<uint8_t>("IHDR"[i]);
    i -= 4u;
    // Data
    if (i < 13u) {
      if (i < 4u) return static_cast<uint8_t>((W >> (24u - 8u * i)) & 0xFFu);
      i -= 4u;
      if (i < 4u) return static_cast<uint8_t>((H >> (24u - 8u * i)) & 0xFFu);
      i -= 4u;
      const uint8_t rest[5] = {8, 2, 0, 0, 0};
      return rest[i];
    }
    i -= 13u;
    // CRC32
    return static_cast<uint8_t>((snap->ihdrCrc32 >> (24u - 8u * i)) & 0xFFu);
  }

  // IDAT chunk [33..33 + 4 + 4 + IDAT_PAYLOAD_SIZE + 4 - 1]
  const uint32_t IDAT_PAYLOAD_SIZE = snap->idatPayloadSize;
  const uint32_t IDAT_TOTAL = 4u + 4u + IDAT_PAYLOAD_SIZE + 4u;
  const uint32_t IDAT_END = 33u + IDAT_TOTAL;

  if (offset < IDAT_END) {
    uint32_t i = offset - 33u;

    // Chunk length (4 bytes BE)
    if (i < 4u) {
      return static_cast<uint8_t>((IDAT_PAYLOAD_SIZE >> (24u - 8u * i)) &
                                  0xFFu);
    }
    i -= 4u;

    // Chunk type "IDAT"
    if (i < 4u) return static_cast<uint8_t>("IDAT"[i]);
    i -= 4u;

    // ---- IDAT payload ----
    // zlib header
    if (i < 2u) return i == 0u ? 0x78u : 0x01u;
    i -= 2u;

    // DEFLATE stored blocks
    const uint32_t BLOCKS_SIZE = H * ROW_STRIDE;
    if (i < BLOCKS_SIZE) {
      uint32_t row = i / ROW_STRIDE;
      uint32_t col = i % ROW_STRIDE;

      // DEFLATE stored block header (5 bytes)
      if (col < 5u) {
        bool lastRow = (row == H - 1u);
        uint16_t len16 = static_cast<uint16_t>(LEN);
        uint16_t nlen16 = ~len16;
        switch (col) {
          case 0: return lastRow ? 0x01u : 0x00u;
          case 1: return static_cast<uint8_t>(len16 & 0xFFu);
          case 2: return static_cast<uint8_t>(len16 >> 8u);
          case 3: return static_cast<uint8_t>(nlen16 & 0xFFu);
          case 4: return static_cast<uint8_t>(nlen16 >> 8u);
        }
      }
      col -= 5u;

      // Filter byte
      if (col == 0u) return 0x00u;
      col -= 1u;

      // RGB888 pixel data
      uint32_t x = col / 3u;
      uint32_t ch = col % 3u;
      uint8_t r, g, b;
      rgb565To888(snapshotPixelAt(snap, x, row), r, g, b);
      return ch == 0u ? r : ch == 1u ? g : b;
    }
    i -= BLOCKS_SIZE;

    // Adler-32 (4 bytes BE)
    if (i < 4u) {
      return static_cast<uint8_t>((snap->adler32 >> (24u - 8u * i)) & 0xFFu);
    }
    i -= 4u;

    // IDAT chunk CRC32 (4 bytes BE)
    if (i < 4u) {
      return static_cast<uint8_t>((snap->idatCrc32 >> (24u - 8u * i)) & 0xFFu);
    }
    return 0u;
  }

  // IEND chunk [IDAT_END..IDAT_END+11]: length=0, "IEND", crc=0xAE426082
  if (offset < snap->fileSize) {
    static const uint8_t IEND[12] = {0,   0,   0,    0,    'I',  'E',
                                     'N', 'D', 0xAE, 0x42, 0x60, 0x82};
    return IEND[offset - IDAT_END];
  }

  return 0u;
}

// =============================================================================
// Virtual FAT12 disk
// =============================================================================

static constexpr uint32_t DISK_SECTOR_SIZE = 512u;
static constexpr uint32_t DISK_SECTOR_COUNT = 1024u;  // 512 KB virtual disk
static constexpr uint32_t FAT_SECTOR_START = 1u;
static constexpr uint32_t FAT_SECTOR_COUNT =
    3u;  // holds up to 1021 FAT12 entries
static constexpr uint32_t ROOT_DIR_SECTOR = 4u;
static constexpr uint32_t DATA_SECTOR_START = 5u;  // cluster 2 → sector 5

// Returns the FAT12 value for cluster `n`.
// frame_buffer.png occupies clusters 2..2+numPngClusters-1.
static uint16_t fat12Entry(uint32_t n, uint32_t numPngClusters) {
  if (n == 0u) return 0xFF8u;              // media descriptor
  if (n == 1u) return 0xFFFu;              // volume end-of-chain
  uint32_t pngLast = 1u + numPngClusters;  // last PNG cluster
  if (n >= 2u && n <= pngLast)
    return (n == pngLast) ? 0xFFFu : static_cast<uint16_t>(n + 1u);
  return 0x000u;  // free
}

// Fill one FAT sector (s = 0-based index from FAT area start).
static void fillFatSector(uint8_t *buf, uint32_t s, uint32_t numFileClusters) {
  memset(buf, 0, DISK_SECTOR_SIZE);
  uint32_t byteStart = s * DISK_SECTOR_SIZE;
  uint32_t byteEnd = byteStart + DISK_SECTOR_SIZE;
  // Each group of 3 bytes encodes two 12-bit FAT entries
  uint32_t firstGroup = byteStart / 3u;
  uint32_t lastGroup = (byteEnd - 1u) / 3u;
  for (uint32_t g = firstGroup; g <= lastGroup; ++g) {
    uint16_t ea = fat12Entry(g * 2u, numFileClusters);
    uint16_t eb = fat12Entry(g * 2u + 1u, numFileClusters);
    uint8_t gb[3] = {
        static_cast<uint8_t>(ea & 0xFFu),
        static_cast<uint8_t>(((eb & 0x0Fu) << 4u) | ((ea >> 8u) & 0x0Fu)),
        static_cast<uint8_t>((eb >> 4u) & 0xFFu),
    };
    for (uint32_t bi = 0; bi < 3u; ++bi) {
      uint32_t fatByte = g * 3u + bi;
      if (fatByte >= byteStart && fatByte < byteEnd)
        buf[fatByte - byteStart] = gb[bi];
    }
  }
}

// Checksum for 8.3 short name "FRAMEBUFPNG" = 0xCB (precomputed).
static constexpr uint8_t LFN_CHECKSUM = 0xCBu;

// Fill root directory sector with:
//   Entry 0: LFN seq=0x42 (chars 13-16 + null of "frame_buffer.png")
//   Entry 1: LFN seq=0x01 (chars 0-12 of "frame_buffer.png")
//   Entry 2: 8.3 short entry "FRAMEBUF.PNG"
static void fillRootDir(uint8_t *buf, uint32_t fileSize) {
  memset(buf, 0, DISK_SECTOR_SIZE);

  // LFN entry 2 (sequence 0x42 = last, chars 13..): 'p','n','g','\0',padding
  {
    uint8_t *e = buf;
    e[0] = 0x42u;  // last LFN entry
    // chars 13-17 (bytes 1-10): 'p','n','g','\0',0xFFFF
    const uint8_t c1[10] = {0x70, 0x00, 0x6E, 0x00, 0x67,
                            0x00, 0x00, 0x00, 0xFF, 0xFF};
    memcpy(e + 1, c1, 10);
    e[11] = 0x0Fu;
    e[12] = 0x00u;
    e[13] = LFN_CHECKSUM;
    // chars 18-23 (bytes 14-25): all 0xFFFF
    memset(e + 14, 0xFF, 12);
    e[26] = 0x00u;
    e[27] = 0x00u;
    // chars 24-25 (bytes 28-31): all 0xFFFF
    memset(e + 28, 0xFF, 4);
  }

  // LFN entry 1 (sequence 0x01, chars 0-12):
  // 'f','r','a','m','e','_','b','u','f','f','e','r','.'
  {
    uint8_t *e = buf + 32u;
    e[0] = 0x01u;
    // chars 0-4 (bytes 1-10): 'f','r','a','m','e'
    const uint8_t c1[10] = {0x66, 0x00, 0x72, 0x00, 0x61,
                            0x00, 0x6D, 0x00, 0x65, 0x00};
    memcpy(e + 1, c1, 10);
    e[11] = 0x0Fu;
    e[12] = 0x00u;
    e[13] = LFN_CHECKSUM;
    // chars 5-10 (bytes 14-25): '_','b','u','f','f','e'
    const uint8_t c2[12] = {0x5F, 0x00, 0x62, 0x00, 0x75, 0x00,
                            0x66, 0x00, 0x66, 0x00, 0x65, 0x00};
    memcpy(e + 14, c2, 12);
    e[26] = 0x00u;
    e[27] = 0x00u;
    // chars 11-12 (bytes 28-31): 'r','.'
    const uint8_t c3[4] = {0x72, 0x00, 0x2E, 0x00};
    memcpy(e + 28, c3, 4);
  }

  // 8.3 directory entry
  {
    uint8_t *e = buf + 64u;
    // Name: "FRAMEBUF" (8 bytes)
    const uint8_t name83[11] = {'F', 'R', 'A', 'M', 'E', 'B',
                                'U', 'F', 'P', 'N', 'G'};
    memcpy(e, name83, 11);
    e[11] = 0x20u;  // archive attribute
    e[26] = 0x02u;  // first cluster low = 2
    e[27] = 0x00u;
    // File size (4 bytes LE)
    e[28] = static_cast<uint8_t>(fileSize & 0xFFu);
    e[29] = static_cast<uint8_t>((fileSize >> 8u) & 0xFFu);
    e[30] = static_cast<uint8_t>((fileSize >> 16u) & 0xFFu);
    e[31] = static_cast<uint8_t>((fileSize >> 24u) & 0xFFu);
  }
}

// Fill boot sector (BPB for FAT12).
static void fillBootSector(uint8_t *buf, uint32_t volumeSerial) {
  memset(buf, 0, DISK_SECTOR_SIZE);
  // Jump + NOP
  buf[0] = 0xEBu;
  buf[1] = 0x58u;
  buf[2] = 0x90u;
  // OEM name
  memcpy(buf + 3, "MSDOS5.0", 8);
  // BPB
  buf[11] = static_cast<uint8_t>(DISK_SECTOR_SIZE & 0xFFu);  // bytes/sector lo
  buf[12] = static_cast<uint8_t>(DISK_SECTOR_SIZE >> 8u);    // bytes/sector hi
  buf[13] = 1u;                                              // sectors/cluster
  buf[14] = 1u;   // reserved sectors lo
  buf[15] = 0u;   // reserved sectors hi
  buf[16] = 1u;   // number of FATs
  buf[17] = 16u;  // root entry count lo
  buf[18] = 0u;   // root entry count hi
  buf[19] =
      static_cast<uint8_t>(DISK_SECTOR_COUNT & 0xFFu);  // total sectors16 lo
  buf[20] =
      static_cast<uint8_t>(DISK_SECTOR_COUNT >> 8u);  // total sectors16 hi
  buf[21] = 0xF8u;                                    // media type
  buf[22] = static_cast<uint8_t>(FAT_SECTOR_COUNT & 0xFFu);  // FAT size lo
  buf[23] = static_cast<uint8_t>(FAT_SECTOR_COUNT >> 8u);    // FAT size hi
  // Sectors/track, heads, hidden sectors: left as 0
  // Extended BPB
  buf[36] = 0x80u;  // drive number
  buf[38] = 0x29u;  // extended boot signature
  buf[39] = static_cast<uint8_t>(volumeSerial & 0xFFu);
  buf[40] = static_cast<uint8_t>((volumeSerial >> 8u) & 0xFFu);
  buf[41] = static_cast<uint8_t>((volumeSerial >> 16u) & 0xFFu);
  buf[42] = static_cast<uint8_t>((volumeSerial >> 24u) & 0xFFu);
  memcpy(buf + 43, "LCDTAP     ", 11);
  memcpy(buf + 54, "FAT12   ", 8);
  buf[510] = 0x55u;
  buf[511] = 0xAAu;
}

// Generate the 512-byte sector for `lba` into `buf`.
// Boot/FAT/root sectors use pre-computed gFileSizeUsb (no framebuf needed).
// Data sectors trigger a lazy snapshot on first access so that
// processInputBuf() has had time to fill the framebuffer while the OS scanned
// the metadata sectors.
static void generateSector(uint32_t lba, uint8_t *buf) {
  memset(buf, 0, DISK_SECTOR_SIZE);
  if (lba == 0u) {
    // The host re-reads the boot sector on each drive scan (e.g. when the user
    // opens the file explorer). Reset the snapshot flag so the next file copy
    // gets a fresh framebuffer capture.
    gSnapReady = false;
    // Change the volume serial on each boot-sector read to discourage
    // host-side cache reuse of file contents.
    gVolumeSerialUsb += 1;
    fillBootSector(buf, gVolumeSerialUsb);
  } else if (lba >= FAT_SECTOR_START &&
             lba < FAT_SECTOR_START + FAT_SECTOR_COUNT) {
    uint32_t numClusters =
        (gFileSizeUsb + DISK_SECTOR_SIZE - 1u) / DISK_SECTOR_SIZE;
    fillFatSector(buf, lba - FAT_SECTOR_START, numClusters);
  } else if (lba == ROOT_DIR_SECTOR) {
    fillRootDir(buf, gFileSizeUsb);
  } else if (lba >= DATA_SECTOR_START) {
    if (!gSnapReady) {
      pngSnapshotInit(&gSnap, gInstUsb);
      gSnapReady = true;
    }
    uint32_t byteOffset = (lba - DATA_SECTOR_START) * DISK_SECTOR_SIZE;
    for (uint32_t i = 0u; i < DISK_SECTOR_SIZE; ++i) {
      uint32_t fileOff = byteOffset + i;
      buf[i] = (fileOff < gSnap.fileSize) ? pngByteAt(&gSnap, fileOff) : 0u;
    }
  }
}

// =============================================================================
// USB descriptors
// =============================================================================

static constexpr uint8_t EPNUM_MSC_OUT = 0x01u;
static constexpr uint8_t EPNUM_MSC_IN = 0x81u;

enum { ITF_NUM_MSC = 0, ITF_NUM_TOTAL };

static tusb_desc_device_t const descDevice = {
    .bLength = sizeof(tusb_desc_device_t),
    .bDescriptorType = TUSB_DESC_DEVICE,
    .bcdUSB = 0x0200,
    .bDeviceClass = 0x00,
    .bDeviceSubClass = 0x00,
    .bDeviceProtocol = 0x00,
    .bMaxPacketSize0 = 64,
    .idVendor = 0x2E8Au,
    .idProduct = 0xAAAAu,
    .bcdDevice = 0x0100,
    .iManufacturer = 0x01,
    .iProduct = 0x02,
    .iSerialNumber = 0x03,
    .bNumConfigurations = 0x01,
};

#define CONFIG_TOTAL_LEN (TUD_CONFIG_DESC_LEN + TUD_MSC_DESC_LEN)

static uint8_t const descConfiguration[] = {
    TUD_CONFIG_DESCRIPTOR(1, ITF_NUM_TOTAL, 0, CONFIG_TOTAL_LEN, 0x00, 100),
    TUD_MSC_DESCRIPTOR(ITF_NUM_MSC, 0, EPNUM_MSC_OUT, EPNUM_MSC_IN, 64),
};

enum {
  STRID_LANGID = 0,
  STRID_MANUFACTURER,
  STRID_PRODUCT,
  STRID_SERIAL,
};

uint8_t const *tud_descriptor_device_cb(void) {
  return reinterpret_cast<uint8_t const *>(&descDevice);
}

uint8_t const *tud_descriptor_configuration_cb(uint8_t /*index*/) {
  return descConfiguration;
}

uint16_t const *tud_descriptor_string_cb(uint8_t index, uint16_t /*langid*/) {
  static uint16_t descStr[32];
  uint8_t count;

  if (index == STRID_LANGID) {
    descStr[1] = 0x0409u;
    count = 1;
  } else if (index == STRID_SERIAL) {
    pico_unique_board_id_t uid;
    pico_get_unique_board_id(&uid);
    count = 0;
    for (int i = 0; i < 8 && count < 16; ++i) {
      uint8_t b = uid.id[i];
      descStr[1 + count++] = "0123456789ABCDEF"[b >> 4u];
      descStr[1 + count++] = "0123456789ABCDEF"[b & 0x0Fu];
    }
  } else {
    static const char *const kStrings[] = {
        nullptr,
        "LcdTap",
        "Frame Buffer",
    };
    if (index >= sizeof(kStrings) / sizeof(kStrings[0]) || !kStrings[index])
      return nullptr;
    const char *str = kStrings[index];
    count = 0;
    while (str[count] && count < 31u) {
      descStr[1 + count] = static_cast<uint8_t>(str[count]);
      ++count;
    }
  }

  descStr[0] =
      static_cast<uint16_t>((TUSB_DESC_STRING << 8u) | (2u * count + 2u));
  return descStr;
}

// =============================================================================
// TinyUSB MSC callbacks
// =============================================================================

bool tud_msc_test_unit_ready_cb(uint8_t /*lun*/) { return true; }

void tud_msc_inquiry_cb(uint8_t /*lun*/, uint8_t vendor_id[8],
                        uint8_t product_id[16], uint8_t product_rev[4]) {
  memcpy(vendor_id, "LcdTap  ", 8);
  memcpy(product_id, "Frame Buffer    ", 16);
  memcpy(product_rev, "1.0 ", 4);
}

void tud_msc_capacity_cb(uint8_t /*lun*/, uint32_t *block_count,
                         uint16_t *block_size) {
  *block_count = DISK_SECTOR_COUNT;
  *block_size = static_cast<uint16_t>(DISK_SECTOR_SIZE);
}

bool tud_msc_start_stop_cb(uint8_t /*lun*/, uint8_t /*power_condition*/,
                           bool /*start*/, bool /*load_eject*/) {
  return true;
}

bool tud_msc_is_writable_cb(uint8_t /*lun*/) { return false; }

int32_t tud_msc_read10_cb(uint8_t /*lun*/, uint32_t lba, uint32_t offset,
                          void *buffer, uint32_t bufsize) {
  if (lba >= DISK_SECTOR_COUNT) return -1;
  uint8_t sector[DISK_SECTOR_SIZE];
  generateSector(lba, sector);
  uint32_t avail = DISK_SECTOR_SIZE - offset;
  uint32_t n = bufsize < avail ? bufsize : avail;
  memcpy(buffer, sector + offset, n);
  return static_cast<int32_t>(n);
}

int32_t tud_msc_write10_cb(uint8_t /*lun*/, uint32_t /*lba*/,
                           uint32_t /*offset*/, uint8_t * /*buffer*/,
                           uint32_t /*bufsize*/) {
  return -1;  // read-only
}

int32_t tud_msc_scsi_cb(uint8_t /*lun*/, uint8_t const /*scsi_cmd*/[16],
                        void * /*buffer*/, uint16_t /*bufsize*/) {
  return -1;
}

// =============================================================================
// Entry point
// =============================================================================

[[noreturn]] void runUsbMassStorage(lcdtap::LcdTap *inst,
                                    void (*processInputCb)()) {
  gInstUsb = inst;
  gSnapReady = false;

  // Capture display transform config for USB snapshot generation.
  // These values are frozen into each snapshot when the host reads data
  // sectors.
  {
    const lcdtap::LcdTapConfig cfg = inst->getConfig();
    gOutputRotationUsb = cfg.outputRotation & 3u;
    gInvertedUsb = inst->isOutputInverted();
    gSwapRbUsb = inst->isOutputSwapRB();

    const uint32_t W =
        (gOutputRotationUsb & 1u) != 0u ? cfg.lcdHeight : cfg.lcdWidth;
    const uint32_t H =
        (gOutputRotationUsb & 1u) != 0u ? cfg.lcdWidth : cfg.lcdHeight;
    const uint32_t ROW_STRIDE = 5u + 1u + W * 3u;
    const uint32_t IDAT_PAYLOAD_SIZE = 2u + H * ROW_STRIDE + 4u;
    gFileSizeUsb = 8u + 25u + (4u + 4u + IDAT_PAYLOAD_SIZE + 4u) + 12u;
  }

  tusb_init();

  while (true) {
    tud_task();

    // Keep draining LCD input into the framebuffer continuously.
    // The snapshot (in generateSector) captures Adler-32/CRC32 once per copy;
    // if the framebuffer changes afterwards the checksums may drift, but PNG
    // decoders tolerate this and the pixel content will be current.
    if (processInputCb) {
      processInputCb();
    }

    // Enter key (active-low) → watchdog reset back to DVI mode.
    // bootMode was already written as DVI_OUTPUT before this function ran.
    if (!gpio_get(PIN_KEY_ENTER)) {
      sleep_ms(50);
      if (!gpio_get(PIN_KEY_ENTER)) {
        watchdog_reboot(0, 0, 0);
        watchdog_enable(1, false);
        for (;;) tight_loop_contents();
      }
    }
  }
}
